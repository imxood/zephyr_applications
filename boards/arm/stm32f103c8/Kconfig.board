## boards/arm/stm32f103c8/Kconfig.board
```kconfig
# STM32F103C8T6 Mini board configuration

# Copyright (c) 2020 maxu
# SPDX-License-Identifier: Apache-2.0

config BOARD_STM32F103C8T6
	bool "STM32F103C8T6 Mini Board"
	depends on SOC_STM32F103XB
```

## boards/arm/stm32f103c8/Kconfig.defconfig
```kconfig
# STM32F103C8T6 Mini board configuration

# Copyright (c) 2020 WuhanStudio
# SPDX-License-Identifier: Apache-2.0

if BOARD_STM32F103C8T6

config BOARD
	default "STM32F103C8T6"

endif # BOARD_STM32F103C8T6
```

## boards/arm/stm32f103c8/stm32f103c8_defconfig
```kconfig
CONFIG_SOC_SERIES_STM32F1X=y
CONFIG_SOC_STM32F103XB=y
# 72MHz system clock
CONFIG_SYS_CLOCK_HW_CYCLES_PER_SEC=72000000

# enable pinmux
CONFIG_PINMUX=y

# enable GPIO
CONFIG_GPIO=y

# clock configuration
CONFIG_CLOCK_CONTROL=y
CONFIG_CLOCK_STM32_SYSCLK_SRC_PLL=y
# Use the internal 8MHz clock
CONFIG_CLOCK_STM32_PLL_SRC_HSI=y
# produce 72MHz clock at PLL output
CONFIG_CLOCK_STM32_PLL_MULTIPLIER=9
CONFIG_CLOCK_STM32_AHB_PRESCALER=1
# APB1 clock must not to exceed 36MHz limit
CONFIG_CLOCK_STM32_APB1_PRESCALER=2
CONFIG_CLOCK_STM32_APB2_PRESCALER=1
```

## boards/arm/stm32f767ig/Kconfig.board
```kconfig
# STM32F767I board configuration

# Copyright (c) 2021 maxu
# SPDX-License-Identifier: Apache-2.0

config BOARD_STM32F767IG
	bool "STM32F767IG Board"
	depends on SOC_STM32F767XX
```

## boards/arm/stm32f767ig/Kconfig.defconfig
```kconfig
# STM32F767IG board configuration

# Copyright (c) 2021 maxu
# SPDX-License-Identifier: Apache-2.0

if BOARD_STM32F767IG

config BOARD
	default "stm32f767ig"

config SPI_STM32_INTERRUPT
	default y
	depends on SPI

if NETWORKING

config NET_L2_ETHERNET
	default y

endif # NETWORKING

endif # BOARD_STM32F767I
```

## boards/arm/stm32h750vbt6/Kconfig.board
```kconfig
# STM32H750 StarStar Develop board configuration

# Copyright (c) 2020 StarStar
# SPDX-License-Identifier: Apache-2.0

config BOARD_STM32H750VBT6
	bool "STM32H750 StarStar Development Board"
	depends on SOC_STM32H750XX
	select CPU_CORTEX_M7
```

## boards/arm/stm32h750vbt6/Kconfig.defconfig
```kconfig
# STM32H750VBT6 starstar board configuration

# Copyright (c) 2020 StarStar Limited
# SPDX-License-Identifier: Apache-2.0

if BOARD_STM32H750VBT6

config BOARD
	default "stm32h750vbt6" if BOARD_STM32H750VBT6

# clock configuration
config SYS_CLOCK_HW_CYCLES_PER_SEC
	default 400000000

config CLOCK_STM32_D1CPRE
	default 1

config CLOCK_STM32_HPRE
	# HCLK: 200MHz
	default 2

config CLOCK_STM32_D2PPRE1
	# APBX: 100MHz
	default 2

config CLOCK_STM32_D2PPRE2
	default 2

config CLOCK_STM32_D1PPRE
	default 2

config CLOCK_STM32_D3PPRE
	default 2

config STM32H7_DUAL_CORE
	default n

# Dual core boot configuration. Boot method is selected in common file to avoid
# desync issues.
choice STM32H7_DUAL_CORE_BOOT
	# Use out of the box config by default
	# default STM32H7_BOOT_CM4_CM7
	default STM32H7_BOOT_CM7_CM4GATED
	depends on STM32H7_DUAL_CORE
endchoice

endif # BOARD_STM32H750VBT6
```
