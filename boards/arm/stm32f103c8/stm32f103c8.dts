/*
 * Copyright (c) 2021 maxu
 *
 * SPDX-License-Identifier: Apache-2.0
 */

/dts-v1/;
#include <st/f1/stm32f103X8.dtsi>
#include <st/f1/stm32f103r(c-d-e)tx-pinctrl.dtsi>

/ {
	model = "stm32f103c8 board";
	compatible = "st,stm32f103";

	chosen {
		zephyr,console = &usart2;
		zephyr,shell-uart = &usart2;
		zephyr,sram = &sram0;
		zephyr,flash = &flash0;
	};

};

&usart2 {
	pinctrl-0 = <&usart2_rx_pa3 &usart2_tx_pa2>;
	current-speed = <115200>;
	status = "okay";
};

// &i2c1 {
// 	pinctrl-0 = <&i2c1_scl_pb8 &i2c1_sda_pb9>;
// 	status = "okay";
// 	clock-frequency = <I2C_BITRATE_FAST>;
// };

// &spi1 {
// 	pinctrl-0 = <&spi1_nss_master_pa4 &spi1_sck_master_pa5
// 	&spi1_miso_master_pa6 &spi1_mosi_master_pa7>;
// 	status = "okay";
// };

&usb {
	pinctrl-0 = <&usb_dm_pa11 &usb_dp_pa12>;
	status = "okay";
};