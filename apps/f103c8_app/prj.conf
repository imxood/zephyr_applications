## CMakeLists.txt
```
cmake_minimum_required(VERSION 3.13.1)

# set(DTC_OVERLAY_FILE "${CMAKE_CURRENT_SOURCE_DIR}/custom.overlay")

find_package(Zephyr REQUIRED HINTS $ENV{ZEPHYR_BASE})
project(f103c8_app)

target_sources(
  app
  PRIVATE
  src/main.c
  # src/usb.c
)
```

## prj.conf
```kconfig
CONFIG_NO_OPTIMIZATIONS=y

# CONFIG_REBOOT=y

# CONFIG_I2C=y

# CONFIG_SPI=y
# CONFIG_SPI_0=y

# CONFIG_LOG=y
# CONFIG_LOG_MODE_IMMEDIATE=y
# # CONFIG_LOG_BUFFER_SIZE=4096


# # enable uart driver
# CONFIG_SERIAL=y
# # enable console
# CONFIG_CONSOLE=y
# CONFIG_UART_CONSOLE=y
# # CONFIG_USB_UART_CONSOLE=y


# # CONFIG_SHELL=y

# CONFIG_USB=y
# CONFIG_USB_DEVICE_STACK=y
# CONFIG_USB_DRIVER_LOG_LEVEL_DBG=y
# CONFIG_USB_DEVICE_LOG_LEVEL_DBG=y

# CONFIG_USB_DEVICE_VID=0x1234
# CONFIG_USB_DEVICE_PID=0x4321

# # CONFIG_USB_DEVICE_HID=y
# # CONFIG_ENABLE_HID_INT_OUT_EP=y
# # CONFIG_USB_HID_LOG_LEVEL_DBG=y

# CONFIG_USB_CDC_ACM=y
# CONFIG_USB_COMPOSITE_DEVICE=y
# CONFIG_USB_CDC_ACM_LOG_LEVEL_DBG=y
```

## src/main.c
```c
#include <sys/printk.h>
#include <zephyr.h>

static K_SEM_DEFINE(my_sem, 0, 1);

void main(void)
{
    while (1)
    {
        printk("Hello World! %s\n", CONFIG_BOARD);
        k_sleep(K_MSEC(10));
    }
}

void test_thread1(void *p1, void *p2, void *p3)
{
    k_sem_take(&my_sem, K_FOREVER);
    printk("Hello World! %s\n", CONFIG_BOARD);
}

void test_thread2(void *p1, void *p2, void *p3)
{
    k_sleep(K_SECONDS(1));
    k_sem_give(&my_sem);
}

K_THREAD_DEFINE(test_tid1, 1024, test_thread1, NULL, NULL, NULL, CONFIG_APPLICATION_INIT_PRIORITY, 0, 0);
K_THREAD_DEFINE(test_tid2, 1024, test_thread2, NULL, NULL, NULL, CONFIG_APPLICATION_INIT_PRIORITY, 0, 0);
```

## src/usb.c
```c
#include <usb/usb_device.h>
#include <zephyr.h>

static void fn_usb_dc_status_callback(enum usb_dc_status_code cb_status, const uint8_t *param)
{
    printk("cb_status: %d\n", cb_status);
}

int usb_init(const struct device *dev)
{
    int ret = 0;
    printk("Hello World! %s\n", CONFIG_BOARD);
    ret = usb_enable(fn_usb_dc_status_callback);
    if (ret)
    {
        printk("usb enable failed\n");
        return ret;
    }
    return ret;
}

SYS_INIT(usb_init, APPLICATION, CONFIG_APPLICATION_INIT_PRIORITY);
```
